## EXT_BOARDS/robopill/Kconfig
```kconfig
# Copyright (c) 2020 Inria
#
# This file is subject to the terms and conditions of the GNU Lesser
# General Public License v2.1. See the file LICENSE in the top level
# directory for more details.
#

config BOARD
    default "robopill" if BOARD_ROBOPILL

config BOARD_ROBOPILL
    bool
    default y
    select BOARD_COMMON_BLXXXPILL
    select CPU_MODEL_STM32F103CB
    select MODULE_BOARDS_COMMON_BLXXXPILL if TEST_KCONFIG

    select HAS_HIGHLEVEL_STDIO

source "$(RIOTBOARD)/common/blxxxpill/Kconfig"
```
